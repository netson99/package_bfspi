## package_bfspi/Config.in
```kconfig
#########################################################################
# This program is free software; you can redistribute it and/or modify
# it under the terms of the GNU General Public License as published by
# The Free Software Foundation; version 3 of the License.
#
# This program is distributed in the hope that it will be useful,
# but WITHOUT ANY WARRANTY; without even the implied warranty of
# MERCHANTABILITY or FITNESS FOR A PARTICULAR PURPOSE.  See the
# GNU General Public License for more details.
# Copyright @ 2010 SwitchFin <dpn@switchfin.org>
#########################################################################

config SF_PACKAGE_BFSPI_EXTRATOOLS
	bool "BFSPI Tools"
	default n
	help
		Enable BFSPI modules (bfsi as general linux char device)
```
